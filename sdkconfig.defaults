## sdkconfig.defaults
```kconfig
# Default sdkconfig settings — Target: ESP32-S3 (Tasmota32S3 Hardware Match)
# ============================================================
# Target chip
CONFIG_IDF_TARGET="esp32s3"

# CPU frequency 240MHz (max for ESP32-S3)
CONFIG_ESP_DEFAULT_CPU_FREQ_MHZ_240=y

# System event queue & task stacks
CONFIG_ESP_SYSTEM_EVENT_QUEUE_SIZE=32
CONFIG_ESP_SYSTEM_EVENT_TASK_STACK_SIZE=4096
CONFIG_MAIN_TASK_STACK_SIZE=8192

# HTTP Server — allow larger headers for web pages
CONFIG_HTTPD_MAX_REQ_HDR_LEN=2048
CONFIG_HTTPD_MAX_URI_LEN=2048

# FreeRTOS tick 1000Hz (1ms resolution)
CONFIG_FREERTOS_HZ=1000

# Custom partition table (supports OTA)
CONFIG_PARTITION_TABLE_CUSTOM=y
CONFIG_PARTITION_TABLE_CUSTOM_FILENAME="partitions.csv"
CONFIG_PARTITION_TABLE_FILENAME="partitions.csv"
CONFIG_PARTITION_TABLE_OFFSET=0x8000
CONFIG_PARTITION_TABLE_MD5=y

# Flash: 16MB, DIO mode, 80MHz (Matches ESP32-S3 N16R8)
CONFIG_ESPTOOLPY_FLASHSIZE_16MB=y
CONFIG_ESPTOOLPY_FLASHSIZE="16MB"
CONFIG_ESPTOOLPY_FLASHMODE_DIO=y
CONFIG_ESPTOOLPY_FLASHFREQ_80M=y

# TLS certificate bundle for HTTPS OTA
CONFIG_MBEDTLS_CERTIFICATE_BUNDLE=y
CONFIG_MBEDTLS_CERTIFICATE_BUNDLE_DEFAULT_FULL=y

# ESP32-S3: Console UART0
CONFIG_ESP_CONSOLE_UART_DEFAULT=y
CONFIG_ESP_CONSOLE_UART_NUM=0
CONFIG_ESP_CONSOLE_USB_SERIAL_JTAG=n

# Enable PSRAM (Matches Tasmota32S3 N16R8)
CONFIG_SPIRAM=y
CONFIG_SPIRAM_MODE_OCT=y
CONFIG_SPIRAM_SPEED_80M=y
CONFIG_SPIRAM_BOOT_INIT=y
CONFIG_SPIRAM_IGNORE_NOTFOUND=y
CONFIG_SPIRAM_USE_MALLOC=y
CONFIG_SPIRAM_TYPE_AUTO=y
```
